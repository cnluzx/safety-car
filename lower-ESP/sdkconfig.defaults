## lower-ESP/sdkconfig.defaults
```kconfig
# 从旧构建产物 build/config/sdkconfig.json 反推整理，均为 ESP32-S3 官方默认值，
# 仅列出对本工程有实际影响的项。其余保持 IDF 默认。
CONFIG_IDF_TARGET="esp32s3"

# Flash：2 MB / DIO / 80 MHz
CONFIG_ESPTOOLPY_FLASHSIZE_2MB=y
CONFIG_ESPTOOLPY_FLASHSIZE="2MB"
CONFIG_ESPTOOLPY_FLASHMODE_DIO=y
CONFIG_ESPTOOLPY_FLASHMODE="dio"
CONFIG_ESPTOOLPY_FLASHFREQ_80M=y
CONFIG_ESPTOOLPY_FLASHFREQ="80m"

# 单 app 分区表（partitions_singleapp.csv），无 OTA
CONFIG_PARTITION_TABLE_SINGLE_APP=y

# 不使用 PSRAM
# CONFIG_SPIRAM is not set

# 日志：INFO 级别
CONFIG_LOG_DEFAULT_LEVEL_INFO=y
CONFIG_LOG_DEFAULT_LEVEL=3

# 编译：-Og 调试优化（电机闭环调参阶段便于单步）
CONFIG_COMPILER_OPTIMIZATION_DEBUG=y

# 系统节拍 100 Hz（vTaskDelay 1 tick = 10 ms）
CONFIG_FREERTOS_HZ=100

# app_main 运行在 CPU0
CONFIG_ESP_MAIN_TASK_AFFINITY_CPU0=y
```
